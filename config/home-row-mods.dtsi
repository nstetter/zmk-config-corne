// taken from https://github.com/urob/zmk-config?tab=readme-ov-file#timeless-homerow-mods

#include "zmk-helpers/key-labels/42.h"

#define KEYS_L LT0 LT1 LT2 LT3 LT4 LT5 LM0 LM1 LM2 LM3 LM4 LM5 LB0 LB1 LB2 LB3 LB4 LB5
#define KEYS_R RT0 RT1 RT2 RT3 RT4 RT5 RM0 RM1 RM2 RM3 RM4 RM5 RB0 RB1 RB2 RB3 RB4 RB5
#define THUMBS LH2 LH1 LH0 RH0 RH1 RH2   

#define HM_TAPPING_TERM 175
#define HM_QUICK_TAP 150
#define HM_PRIOR_IDLE 100

/* left-hand HRMs */
ZMK_HOLD_TAP(hml,
    flavor = "balanced";
    tapping-term-ms = <HM_TAPPING_TERM>;
    quick-tap-ms = <HM_QUICK_TAP>;                // repeat on tap-into-hold
    require-prior-idle-ms = <HM_PRIOR_IDLE>;
    bindings = <&kp>, <&kp>;
    hold-trigger-key-positions = <KEYS_R THUMBS>;
    hold-trigger-on-release;             // delay positional check until key-release
)

/* right-hand HRMs */
ZMK_HOLD_TAP(hmr,
    flavor = "balanced";
    tapping-term-ms = <HM_TAPPING_TERM>;
    quick-tap-ms = <HM_QUICK_TAP>;                // repeat on tap-into-hold
    require-prior-idle-ms = <HM_PRIOR_IDLE>;
    bindings = <&kp>, <&kp>;
    hold-trigger-key-positions = <KEYS_L THUMBS>;
    hold-trigger-on-release;             // delay positional check until key-release
)
